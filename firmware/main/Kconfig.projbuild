## firmware/main/Kconfig.projbuild
```kconfig
menu "Dish counter configuration"

    config DISH_COUNTER_DEV_EUI
        string "LoRaWAN device EUI (16 hexadecimal characters)"
        default ""

    config DISH_COUNTER_APP_EUI
        string "LoRaWAN application EUI (16 hexadecimal characters)"
        default ""

    config DISH_COUNTER_APP_KEY
        string "LoRaWAN application key (32 hexadecimal characters)"
        default ""

endmenu
```
